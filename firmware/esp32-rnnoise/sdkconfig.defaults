## firmware/esp32-rnnoise/sdkconfig.defaults
```kconfig
# ESP32-S3 Supermini - QSPI PSRAM Mode
# Proven working config

# Flash
CONFIG_ESPTOOLPY_FLASHSIZE_4MB=y
CONFIG_ESPTOOLPY_FLASHSIZE="4MB"

# PSRAM - QSPI Mode (Auto-detect usually works better for QSPI)
CONFIG_SPIRAM=y
CONFIG_SPIRAM_MODE_QUAD=y
CONFIG_SPIRAM_TYPE_AUTO=y
CONFIG_SPIRAM_SPEED_80M=y
CONFIG_SPIRAM_IGNORE_NOTFOUND=y

# Allow PSRAM malloc
CONFIG_SPIRAM_USE_MALLOC=y
CONFIG_SPIRAM_MALLOC_ALWAYSINTERNAL=16384

# FreeRTOS
CONFIG_FREERTOS_UNICORE=n

# CPU Frequency
CONFIG_ESP32S3_DEFAULT_CPU_FREQ_240=y
CONFIG_ESP32S3_DEFAULT_CPU_FREQ_MHZ=240
CONFIG_PM_ENABLE=y

# Optimization
CONFIG_COMPILER_OPTIMIZATION_PERF=y
CONFIG_ESP_DSP_OPTIMIZED=y
CONFIG_COMPILER_OPTIMIZATION_LEVEL_PERFORMANCE=y

# Flash/PSRAM Speed
CONFIG_ESPTOOLPY_FLASHFREQ_80M=y
CONFIG_SPIRAM_SPEED_80M=y
```
